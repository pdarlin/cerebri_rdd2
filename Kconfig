## Kconfig
```kconfig
source "Kconfig.zephyr"

config TOP_SHELL
    bool "Enable top-like screen in shell"
    depends on SHELL
    default y

config PWM_FREQUENCY
    int "PWM motors frequency in Hz"
    depends on PWM
    default 400
    
menu "RDD2"

config RDD2_GPIO_TIMING
    bool "Expose processing and IMU acquisition on two GPIOs"
    depends on BOARD_MR_VMU_TROPIC_MIMXRT1064 && !RDD2_LOCKSTEP
    depends on GPIO && SENSOR_ASYNC_API && ICM45686_STREAM
    select PINCTRL
    help
      Bench instrumentation enabled by the gpio-timing snippet. J7 pin 5
      measures processing before motor output; J7 pin 4 measures an accepted
      IMU interrupt through asynchronous acquisition completion.

rsource "subsys/Kconfig"
rsource "drivers/Kconfig"

endmenu
```

## dts/bindings/misc/cognipilot,gpio-timing.yaml
```yaml
description: Processing and IMU acquisition timing probes with explicit pad ownership
compatible: "cognipilot,gpio-timing"
include: [base.yaml, pinctrl-device.yaml]
properties:
  gpios:
    type: phandle-array
    required: true
    description: Active-high processing marker
  imu-gpios:
    type: phandle-array
    required: true
    description: Active-high asynchronous IMU acquisition marker
```
