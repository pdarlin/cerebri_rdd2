## Kconfig
```kconfig
source "Kconfig.zephyr"

config TOP_SHELL
    bool "Enable top-like screen in shell"
    depends on SHELL
    default y

config PWM_FREQUENCY
    int "PWM motors frequency in Hz"
    depends on PWM
    default 400
    
menu "RDD2"

config RDD2_GPIO_TIMING
    bool "Expose control-loop processing on a GPIO"
    depends on BOARD_MR_VMU_TROPIC_MIMXRT1064 && !RDD2_LOCKSTEP
    select GPIO
    select PINCTRL
    help
      Bench instrumentation enabled by the gpio-timing snippet. The output
      is high from input acquisition return through cycle finalization.

rsource "subsys/Kconfig"
rsource "drivers/Kconfig"

endmenu
```

## dts/bindings/misc/cognipilot,gpio-timing.yaml
```yaml
description: Control-loop timing probe with explicit pad ownership
compatible: "cognipilot,gpio-timing"
include: [base.yaml, pinctrl-device.yaml]
properties:
  gpios:
    type: phandle-array
    required: true
    description: Active-high processing marker
```
